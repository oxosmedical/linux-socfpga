// SPDX-License-Identifier:     GPL-2.0
/*
 * Copyright (C) 2024, Intel Corporation
 */
&soc {

	pcie_0_pcie_aglx: pcie@200000000 {
		compatible = "altr,pcie-root-port-4.0";
		reg = <0x60000000 0x00001000>, /* PCIe Subsystem AXI-Lite interface */
		      <0x20010000 0x00008000>, /* Avalon MM Slave of PCIe Configuration Slave port */
		      <0x60080000 0x00001000>; /* PF0 PCI-Compatible Configuration Space Header Type0 Register */
		reg-names = "Txs", "Cra", "Hip";
		interrupt-parent = <&intc>;
		interrupts = <GIC_SPI 0x14 IRQ_TYPE_LEVEL_HIGH>; /* ?? */
		interrupt-controller;
		#interrupt-cells = <0x1>;
		device_type = "pci";
		bus-range = <0x0000000 0x000000ff>;
		ranges = <
                  /* child address */
                  0x82000000 0x00000000 0x00100000
                  /* parent address */
                  0x50100000
                  /* size of region in child address space = 255 MB */
                  0x00000000 0x0ff00000>;
		msi-parent = <&pcie_0_msi_irq>;
		#address-cells = <0x3>;
		#size-cells = <0x2>;
		interrupt-map-mask = <0x0 0x0 0x0 0x7>;
		interrupt-map = <0x0 0x0 0x0 0x1 &pcie_0_pcie_aglx 0x1>,
				<0x0 0x0 0x0 0x2 &pcie_0_pcie_aglx 0x2>,
				<0x0 0x0 0x0 0x3 &pcie_0_pcie_aglx 0x3>,
				<0x0 0x0 0x0 0x4 &pcie_0_pcie_aglx 0x4>;
		status = "disabled";
	};
	pcie_0_msi_irq: msi@20018000 {
		compatible = "altr,msi-1.0";
		reg = <0x20018080 0x00000010>,
		      <0x20018000 0x00000080>;
		reg-names = "csr", "vector_slave";
		interrupt-parent = <&intc>;
		interrupts = <GIC_SPI 0x13 IRQ_TYPE_LEVEL_HIGH>; /* ?? */
		msi-controller;
		num-vectors = <0x20>;
		status = "disabled";
	};
};
